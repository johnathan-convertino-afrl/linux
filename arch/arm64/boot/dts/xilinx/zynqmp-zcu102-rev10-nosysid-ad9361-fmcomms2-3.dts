// SPDX-License-Identifier: GPL-2.0
/*
 * Analog Devices AD-FMCOMMS2-EBZ/AD-FMCOMMS3-EBZ NO SYSID
 * https://wiki.analog.com/resources/eval/user-guides/ad-fmcomms2-ebz
 * https://wiki.analog.com/resources/eval/user-guides/ad-fmcomms3-ebz
 *
 * hdl_project: <fmcomms2/zcu102>
 * board_revision: <>
 *
 * Copyright (C) 2014-2019 Analog Devices Inc.
 */

#include "zynqmp-zcu102-rev10-ad9361-fmcomms2-3.dts"

&axi_sysid_0 {
	status = "disabled";
};
