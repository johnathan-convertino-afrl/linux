// SPDX-License-Identifier: GPL-2.0
/*
 * Analog Devices AD-FMCOMMS5-EBZ
 * https://wiki.analog.com/resources/eval/user-guides/ad-fmcomms5-ebz
 *
 * hdl_project: <fmcomms5/zcu102>
 * board_revision: <>
 *
 * Copyright (C) 2014-2020 Analog Devices Inc.
 */

#include "zynqmp-zcu102-rev10-ad9361-fmcomms5.dts"

&axi_sysid_0 {
	status = "disabled";
};
