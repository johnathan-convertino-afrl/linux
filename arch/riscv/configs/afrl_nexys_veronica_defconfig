## arch/riscv/configs/afrl_nexys_veronica_defconfig
```kconfig
CONFIG_ARCH_NEXYS_VERONICA=y
CONFIG_SYSVIPC=y
CONFIG_POSIX_MQUEUE=y
CONFIG_NO_HZ_IDLE=y
CONFIG_NO_HZ=y
# CONFIG_CLINT_TIMER=y
CONFIG_HIGH_RES_TIMERS=n
CONFIG_BPF_SYSCALL=y
CONFIG_IKCONFIG=y
CONFIG_IKCONFIG_PROC=y
CONFIG_CGROUPS=y
CONFIG_CGROUP_SCHED=y
CONFIG_CFS_BANDWIDTH=y
CONFIG_CGROUP_BPF=y
CONFIG_NAMESPACES=y
CONFIG_USER_NS=y
CONFIG_BLK_DEV_INITRD=y
CONFIG_EXPERT=y
# CONFIG_SYSFS_SYSCALL is not set
CONFIG_PROFILING=y
CONFIG_SOC_SIFIVE=n
CONFIG_SOC_VIRT=n
CONFIG_NONPORTABLE=y
CONFIG_ARCH_RV32I=y
CONFIG_SMP=n
CONFIG_HOTPLUG_CPU=n
CONFIG_PM=n
CONFIG_VIRTUALIZATION=n
CONFIG_KVM=m
CONFIG_JUMP_LABEL=y
CONFIG_MODULES=y
CONFIG_MODULE_UNLOAD=y
CONFIG_NET=y
CONFIG_PACKET=y
CONFIG_UNIX=y
CONFIG_INET=y
CONFIG_IP_MULTICAST=y
CONFIG_IP_ADVANCED_ROUTER=y
CONFIG_IP_PNP=y
CONFIG_IP_PNP_DHCP=y
CONFIG_IP_PNP_BOOTP=y
CONFIG_IP_PNP_RARP=y
CONFIG_DEVTMPFS=y
CONFIG_DEVTMPFS_MOUNT=y
CONFIG_BLK_DEV_LOOP=y
CONFIG_VIRTIO_BLK=n
CONFIG_BLK_DEV_SD=y
CONFIG_VIRTIO_CONSOLE=n
CONFIG_HW_RANDOM=y
CONFIG_HW_RANDOM_VIRTIO=y
CONFIG_SPI=y
CONFIG_SPI_SIFIVE=y
# CONFIG_PTP_1588_CLOCK is not set
CONFIG_FB=y
CONFIG_FRAMEBUFFER_CONSOLE=y
CONFIG_USB=n
CONFIG_USB_STORAGE=y
CONFIG_USB_UAS=y
CONFIG_MMC=y
CONFIG_MMC_SPI=y
CONFIG_RTC_CLASS=y
CONFIG_VIRTIO_PCI=y
CONFIG_VIRTIO_BALLOON=y
CONFIG_VIRTIO_INPUT=y
CONFIG_VIRTIO_MMIO=y
CONFIG_RPMSG_CHAR=y
CONFIG_RPMSG_CTRL=y
CONFIG_RPMSG_VIRTIO=y
CONFIG_EXT4_FS=y
CONFIG_EXT4_FS_POSIX_ACL=y
CONFIG_AUTOFS_FS=y
CONFIG_MSDOS_FS=y
CONFIG_VFAT_FS=y
CONFIG_TMPFS=y
CONFIG_TMPFS_POSIX_ACL=y
CONFIG_HUGETLBFS=y
CONFIG_NFS_FS=y
CONFIG_NFS_V4=y
CONFIG_NFS_V4_1=y
CONFIG_NFS_V4_2=y
CONFIG_ROOT_NFS=y
CONFIG_9P_FS=n
CONFIG_CRYPTO_USER_API_HASH=y
CONFIG_CRYPTO_DEV_VIRTIO=y
CONFIG_PRINTK_TIME=y
CONFIG_DEBUG_FS=n
CONFIG_DEBUG_PAGEALLOC=n
CONFIG_SCHED_STACK_END_CHECK=y
CONFIG_DEBUG_VM=n
CONFIG_DEBUG_VM_PGFLAGS=n
CONFIG_DEBUG_MEMORY_INIT=n
CONFIG_DEBUG_PER_CPU_MAPS=n
CONFIG_SOFTLOCKUP_DETECTOR=n
CONFIG_WQ_WATCHDOG=y
CONFIG_DEBUG_TIMEKEEPING=n
CONFIG_DEBUG_RT_MUTEXES=n
CONFIG_DEBUG_SPINLOCK=n
CONFIG_DEBUG_MUTEXES=n
CONFIG_DEBUG_RWSEMS=n
CONFIG_DEBUG_ATOMIC_SLEEP=n
CONFIG_STACKTRACE=y
CONFIG_DEBUG_LIST=n
CONFIG_DEBUG_PLIST=n
CONFIG_DEBUG_SG=n
# CONFIG_RCU_TRACE is not set
CONFIG_RCU_EQS_DEBUG=n
# CONFIG_FTRACE is not set
# CONFIG_RUNTIME_TESTING_MENU is not set
CONFIG_MEMTEST=n
CONFIG_SPI_ALTERA=y
CONFIG_SERIAL_UARTLITE=y
CONFIG_SERIAL_UARTLITE_CONSOLE=y
CONFIG_EFI=n
CONFIG_RISCV_ISA_ZICBOM=n
CONFIG_RISCV_ISA_ZICBOZ=n
CONFIG_RISCV_ISA_ZBB=n
CONFIG_FPU=n
CONFIG_SUSPEND=n
CONFIG_DEBUG_BUGVERBOSE=n
CONFIG_CC_OPTIMIZE_FOR_SIZE=y
CONFIG_SERIAL_EARLYCON_RISCV_SBI=y
# CONFIG_HZ_1000=y
# CONFIG_HZ=1000
CONFIG_NETDEVICES=y
CONFIG_XILINX_EMACLITE=y
CONFIG_SMSC_PHY=y
CONFIG_GPIOLIB=y
CONFIG_GPIO_XILINX=y
CONFIG_FB_XILINX=y
```
